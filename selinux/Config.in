## selinux/Config.in
```kconfig
#
# For a description of the syntax of this configuration file,
# see scripts/kbuild/config-language.txt.
#

menu "Selinux Utilities"

config AVCSTAT
	bool "avcstat"
	default n
	depends on SELINUX
	help
	  Enable support for avcstat command as a SELinux utility.

config CHCON
	bool "chcon"
	default n
	depends on SELINUX
	help
	  Enable support for chcon command as a SELinux utility.

config FEATURE_CHCON_LONG_OPTIONS
	bool "Enable long options"
	default y
	depends on CHCON && GETOPT_LONG
	help
	  Support long options for the chcon applet.

config GETENFORCE
	bool "getenforce"
	default n
	depends on SELINUX
	help
	  Enable support to get the current mode of SELinux.

config GETSEBOOL
	bool "getsebool"
	default n
	depends on SELINUX
	help
	  Enable support to get SELinux boolean values.

config LOAD_POLICY
	bool "load_policy"
	default n
	depends on SELINUX
	help
	  Enable support for loading SE Linux into the kernel.

config MATCHPATHCON
	bool "matchpathcon"
	default n
	depends on SELINUX
	help
	  Enable support to get default security context of the
	  specified path from the file contexts configuration.

config RUNCON
	bool "runcon"
	default n
	depends on SELINUX
	help
	  Enable support for runcon command as a SELinux utility.

config FEATURE_RUNCON_LONG_OPTIONS
	bool "Enable long options"
	default n
	depends on RUNCON && GETOPT_LONG
	help
	  Support long options for the runcon applet.

config RESTORECON
	bool "restorecon"
	default n
	depends on SELINUX
	help
	  Enable support for restorecon command as a SELinux utility.

config SECON
	bool "secon"
	default n
	depends on SELINUX
	help
	  Enable support for secon command as a SELinux utility.

config FEATURE_SECON_LONG_OPTIONS
	bool "Enable long options"
	default y
	depends on SECON && GETOPT_LONG
	help
	  Support long options for the secon applet.

config SELINUXENABLED
	bool "selinuxenabled"
	default n
	depends on SELINUX
	help
	  Enable support for this command to be used within shell scripts
	  to determine if selinux is enabled.

config SESTATUS
	bool "sestatus"
	default n
	depends on SELINUX
	help
	  Enable support for sestatus command as a SELinux utility.

config SETENFORCE
	bool "setenforce"
	default n
	depends on SELINUX
	help
	  Enable support to modify the mode SELinux is running in.

config SETFILES
	bool "setfiles"
	default n
	depends on SELINUX
	help
	  Enable support for setfiles command as a SELinux utility.

config SETSEBOOL
	bool "setsebool"
	default n
	depends on SELINUX
	help
	  Enable support to set SELinux boolean values.

config TOGGLESEBOOL
	bool "togglesebool"
	default n
	depends on SELINUX
	help
	  Enable support to flip the current value of a boolean.

endmenu
```

## trunk/selinux/Config.in
```kconfig
#
# For a description of the syntax of this configuration file,
# see scripts/kbuild/config-language.txt.
#

menu "Selinux Utilities"

if CONFIG_SELINUX
config CONFIG_AVCSTAT
	bool "avcstat"
	default n
	help
	  Enable support for avcstat command as a SELinux utility.

config CONFIG_CHCON
	bool "chcon"
	default n
	help
	  Enable support for chcon command as a SELinux utility.

config CONFIG_FEATURE_CHCON_LONG_OPTIONS
	bool "Enable long options"
	default y
	depends on CONFIG_CHCON && CONFIG_GETOPT_LONG
	help
	  Support long options for the chcon applet.

config CONFIG_GETENFORCE
	bool "getenforce"
	default n
	help
	  Enable support to get the current mode of SELinux.

config CONFIG_GETSEBOOL
	bool "getsebool"
	default n
	help
	  Enable support to get SELinux boolean values.

config CONFIG_LOAD_POLICY
	bool "load_policy"
	default n
	help
	  Enable support for loading SE Linux into the kernel.

config CONFIG_RUNCON
	bool "runcon"
	default n
	help
	  Enable support for runcon command as a SELinux utility.

config CONFIG_FEATURE_RUNCON_LONG_OPTIONS
	bool "Enable long options"
	default n
	depends on CONFIG_RUNCON && CONFIG_GETOPT_LONG
	help
	  Support long options for the runcon applet.

config CONFIG_RESTORECON
	bool "restorecon"
	default n
	help
	  Enable support for restorecon command as a SELinux utility.

config CONFIG_SELINUXENABLED
	bool "selinuxenabled"
	default n
	help
	  Enable support for this command to be used within shell scripts
	  to determine if selinux is enabled.

config CONFIG_SESTATUS
	bool "sestatus"
	default n
	help
	  Enable support for sestatus command as a SELinux utility.

config CONFIG_SETENFORCE
	bool "setenforce"
	default n
	help
	  Enable support to modify the mode SELinux is running in.

config CONFIG_SETFILES
	bool "setfiles"
	default n
	help
	  Enable support for setfiles command as a SELinux utility.

config CONFIG_SETSEBOOL
	bool "setsebool"
	default n
	help
	  Enable support to set SELinux boolean values.

config CONFIG_TOGGLESEBOOL
	bool "togglesebool"
	default n
	help
	  Enable support to flip the current value of a boolean.
endif

endmenu
```
